## sdkconfig.defaults
```kconfig
# MatrixCube sdkconfig defaults — tuned for ESP32-S3 + 384 WS2812 LEDs + SoftAP + HTTP server.

CONFIG_IDF_TARGET="esp32s3"

# Partitions
CONFIG_PARTITION_TABLE_CUSTOM=y
CONFIG_PARTITION_TABLE_CUSTOM_FILENAME="partitions.csv"

# Flash / PSRAM — board is ESP32-S3 N4R2 (4MB flash, 2MB quad PSRAM).
CONFIG_ESPTOOLPY_FLASHSIZE_4MB=y
CONFIG_SPIRAM=y
CONFIG_SPIRAM_MODE_QUAD=y
CONFIG_SPIRAM_TYPE_ESPPSRAM2=y

# Main task
CONFIG_ESP_MAIN_TASK_STACK_SIZE=8192

# FreeRTOS
CONFIG_FREERTOS_HZ=1000

# HTTP server — allow embedded web assets + websocket
CONFIG_HTTPD_WS_SUPPORT=y
CONFIG_HTTPD_MAX_REQ_HDR_LEN=2048
CONFIG_HTTPD_MAX_URI_LEN=512

# LwIP — SoftAP needs DHCP server; captive portal DNS
CONFIG_LWIP_IPV4_NAPT=y

# Logging
CONFIG_LOG_DEFAULT_LEVEL_INFO=y
```
